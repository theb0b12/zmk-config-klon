## boards/shields/klon/Kconfig.shield
```kconfig
config SHIELD_KLON_LEFT
    def_bool $(shields_list_contains,klon_left)

config SHIELD_KLON_RIGHT
    def_bool $(shields_list_contains,klon_right)
```
